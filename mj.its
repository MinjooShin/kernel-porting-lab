## mj.its
```
/dts-v1/;

/ {
    description = "MJ board FIT image";
    #address-cells = <1>;

    images {
        kernel-0 {
            description = "Linux Kernel";
            data = /incbin/("linux/build/arch/arm64/boot/Image.gz");
            type = "kernel";
            arch = "arm64";
            os = "linux";
            compression = "gzip";
            load = <0x40080000>;
            entry = <0x40080000>;
            hash {algo = "sha1";};
        };
        fdt-mj {
            description = "MJ Board DTB";
            data = /incbin/("linux/build/arch/arm64/boot/dts/mj/mj.dtb");
            type = "flat_dt";
            arch = "arm64";
            compression = "none";
            hash {algo = "sha1";};
        };
        ramdisk-0 {
            description = "buildroot initramfs";
            data = /incbin/("buildroot/output/images/rootfs.cpio.gz");
            type = "ramdisk";
            arch = "arm64";
            os = "linux";
            compression = "none";
            hash {algo = "sha1";};
        };
    };

    configurations {
        default = "conf-1";
        conf-1 {
            description = "kernel + mj dtb + ramdisk";
            kernel = "kernel-0";
            fdt = "fdt-mj";
            ramdisk = "ramdisk-0";
            hash {algo = "sha1";};
        };
    };
};
```
